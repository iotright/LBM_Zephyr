## west.yml
```yaml
# Copyright (c) 2024 Semtech Corporation
# SPDX-License-Identifier: Apache-2.0

manifest:
  projects:
    - name: zephyr
      url: https://github.com/iotright/iotr-zephyr
      revision: main
      import:
        # By using name-allowlist we can clone only the modules that are
        # strictly needed by the application.
        name-allowlist:
          - cmsis_6 # required by the ARM port
          - hal_nordic
          - mcuboot
          - mbedtls

    - name: lora_basics_modem
      path: modules/lib/lora_basics_modem
      url: https://github.com/lora-net/SWL2001
      revision: v4.8.0

  self:
    path: application
```
